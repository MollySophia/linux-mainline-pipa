## Documentation/devicetree/bindings/iio/adc/adi,max14001.yaml
```yaml
# SPDX-License-Identifier: (GPL-2.0 OR BSD-2-Clause)
# Copyright 2023 Analog Devices Inc.
%YAML 1.2
---
$id: http://devicetree.org/schemas/iio/adc/adi,max14001.yaml#
$schema: http://devicetree.org/meta-schemas/core.yaml#

title: Analog Devices MAX14001 ADC

maintainers:
  - Kim Seer Paller <kimseer.paller@analog.com>

description: |
    Single channel 10 bit ADC with SPI interface. Datasheet
    can be found here:
      https://www.analog.com/media/en/technical-documentation/data-sheets/MAX14001-MAX14002.pdf

properties:
  compatible:
    enum:
      - adi,max14001

  reg:
    maxItems: 1

  spi-max-frequency:
    maximum: 5000000

  vref-supply:
    description: Voltage reference to establish input scaling.

required:
  - compatible
  - reg

allOf:
  - $ref: /schemas/spi/spi-peripheral-props.yaml#

unevaluatedProperties: false

examples:
  - |
    spi {
        #address-cells = <1>;
        #size-cells = <0>;

        adc@0 {
            compatible = "adi,max14001";
            reg = <0>;
            spi-max-frequency = <5000000>;
            vref-supply = <&vref_reg>;
        };
    };
...
```
